## boards/shields/darling3_split/Kconfig.shield
```kconfig
config SHIELD_DARLING3_SPLIT_LEFT
    def_bool $(shields_list_contains,darling3_split_left)

config SHIELD_DARLING3_SPLIT_RIGHT
    def_bool $(shields_list_contains,darling3_split_right)
```
