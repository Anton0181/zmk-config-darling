## boards/shields/darling2/Kconfig.defconfig
```kconfig
if SHIELD_DARLING2

config ZMK_KEYBOARD_NAME
    default "darling2"

endif # SHIELD_DARLING2
```

## boards/shields/darling3/Kconfig.defconfig
```kconfig
if SHIELD_DARLING3

config ZMK_KEYBOARD_NAME
    default "darling3"

endif # SHIELD_DARLING3
```

## config/boards/shields/darling/Kconfig.defconfig
```kconfig
if SHIELD_DARLING

# Name must be less than 16 characters long!
config ZMK_KEYBOARD_NAME
    default "darling"

endif
```
